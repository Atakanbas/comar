## PX4-Autopilot/src/drivers/aux_edge_counter/Kconfig
```kconfig
menuconfig DRIVERS_AUX_EDGE_COUNTER
	bool "aux_edge_counter"
	default n
	---help---
		Enable support for AUX pin rising edge counter
```

## PX4-Autopilot/src/drivers/distance_sensor/ydlidar_g2/Kconfig
```kconfig
menuconfig DRIVERS_DISTANCE_SENSOR_YDLIDAR_G2
	bool "YDLidar G2"
	default n
	---help---
		Enable support for YDLidar G2 360-degree laser rangefinder
```
